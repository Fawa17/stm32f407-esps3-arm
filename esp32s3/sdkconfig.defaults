## esp32s3/sdkconfig.defaults
```kconfig
# ---- 目标芯片 ----
CONFIG_IDF_TARGET="esp32s3"

# ---- Flash：N16R8 = 16MB，QIO 80MHz ----
CONFIG_ESPTOOLPY_FLASHSIZE_16MB=y
CONFIG_ESPTOOLPY_FLASHMODE_QIO=y
CONFIG_ESPTOOLPY_FLASHFREQ_80M=y

# ---- PSRAM：8MB Octal（N16R8 是 octal，别选 quad）----
CONFIG_SPIRAM=y
CONFIG_SPIRAM_MODE_OCT=y
CONFIG_SPIRAM_SPEED_80M=y
CONFIG_SPIRAM_BOOT_INIT=y

# ---- 分区表 ----
CONFIG_PARTITION_TABLE_CUSTOM=y
CONFIG_PARTITION_TABLE_CUSTOM_FILENAME="partitions.csv"

# ---- CPU / RTOS ----
CONFIG_ESP_DEFAULT_CPU_FREQ_MHZ_240=y
CONFIG_FREERTOS_HZ=1000

# ---- HTTP 服务器 ----
CONFIG_HTTPD_MAX_REQ_HDR_LEN=1024
CONFIG_HTTPD_MAX_URI_LEN=512
CONFIG_LWIP_MAX_SOCKETS=10

# ---- 日志（调试够了，不刷屏）----
CONFIG_LOG_DEFAULT_LEVEL_INFO=y

# ---- 不用的东西关掉，省空间 ----
CONFIG_BT_ENABLED=n
CONFIG_FREERTOS_USE_TRACE_FACILITY=y
```
